## drivers/staging/android/ion/Kconfig
```kconfig
menuconfig ION
	bool "Ion Memory Manager"
	depends on HAVE_MEMBLOCK
	select GENERIC_ALLOCATOR
	select DMA_SHARED_BUFFER
	---help---
	  Chose this option to enable the ION Memory Manager,
	  used by Android to efficiently allocate buffers
	  from userspace that can be shared between drivers.
	  If you're not using Android its probably safe to
	  say N here.

config ION_EXYNOS
	tristate "Ion for Exynos"
	depends on ARCH_EXYNOS && ION
	select CMA
	help
	  Choose this option if you wish to use ion on a Samsung Exynos.

config ION_EXYNOS_STAT_LOG
	bool "Gathering stats for Exynos ION"
	default y
	depends on ION_EXYNOS && DEBUG_FS
	help
	  Say Y if you need to see some stats info via debugfs

if ION_EXYNOS
source drivers/staging/android/ion/exynos/Kconfig
endif
```
